## sdkconfig.defaults
```kconfig
# --- Bluetooth (KIKAPCSOLVA) ---
CONFIG_BT_ENABLED=n

# --- Wi-Fi & ESP-NOW / Networking ---
CONFIG_ESP_WIFI_ENABLED=y
CONFIG_ESP_WIFI_SOFTAP_SUPPORT=y
CONFIG_ESP_WIFI_STATIC_RX_BUFFER_NUM=10
CONFIG_ESP_WIFI_DYNAMIC_RX_BUFFER_NUM=32

# Console átirányítás USB Serial/JTAG-re
CONFIG_ESP_CONSOLE_UART_DEFAULT=n
CONFIG_ESP_CONSOLE_USB_SERIAL_JTAG=y
CONFIG_ESP_CONSOLE_SECONDARY_NONE=y

# Natív USB CDC jellemezők inicializálása
CONFIG_ESP_INT_WDT=n

# --- Power Management ---
CONFIG_PM_ENABLE=n
```
